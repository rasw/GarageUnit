// ***************************************************************************
// i2c wiring
// Vin = +3.3V
// GND = Gnd
// SCK = SCL last i/o pin
// SDI = SDA second in from last i/o pin
// ***************************************************************************

#include <Wire.h>
#include <SPI.h>
#include <Adafruit_Sensor.h>
#include <Adafruit_BME280.h>    // library I2C address = 0x77h
#include <Adafruit_GFX.h>
#include <Adafruit_SSD1306.h>
#define OLED_RESET 4
Adafruit_SSD1306 display(OLED_RESET);

#define BLUELED 12
#define GREENLED 11
#define REDLED 10
#define XPOS 0
#define YPOS 1

// https://learn.adafruit.com/adafruit-gfx-graphics-library/graphics-primitives

// tool for creating code http://javl.github.io/image2cpp/

const unsigned char LightOFF [] PROGMEM = {
  // 'LightOFF'
  0x00, 0x00, 0x00, 0x00, 0x00, 0x00, 0x00, 0x00, 0x00, 0x00, 0x00, 0x00, 0x00, 0x00, 0x00, 0x00, 
  0x00, 0x00, 0x00, 0xfc, 0x00, 0x00, 0x00, 0x00, 0x00, 0x00, 0x00, 0x00, 0x00, 0x00, 0x00, 0x00, 
  0x00, 0x00, 0x1f, 0xff, 0xe0, 0x00, 0x00, 0x00, 0x00, 0x00, 0x00, 0x00, 0x00, 0x00, 0x00, 0x00, 
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  0x00, 0x00, 0x00, 0x00, 0x00, 0x00, 0x00, 0x00, 0x00, 0x00, 0x00, 0x00, 0x00, 0x00, 0x00, 0x00, 
};

const unsigned char Humidity [] PROGMEM = {
  // 'Humidity'
  0x00, 0x00, 0x00, 0x00, 0x00, 0x00, 0x00, 0x00, 0x00, 0x00, 0x00, 0x00, 0x00, 0x00, 0x00, 0x00, 
  0x00, 0x00, 0xe0, 0x00, 0x00, 0x00, 0x00, 0x00, 0x00, 0x00, 0x00, 0x00, 0x00, 0x00, 0x00, 0x00, 
  0x00, 0x00, 0xf8, 0x00, 0x00, 0x00, 0x00, 0x00, 0x00, 0x00, 0x00, 0x00, 0x00, 0x00, 0x00, 0x00, 
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  0x00, 0x00, 0x00, 0x00, 0x00, 0x00, 0x00, 0x00, 0x00, 0x00, 0x00, 0x00, 0x00, 0x00, 0x00, 0x00, 
};

const unsigned char Pressure [] PROGMEM = {
  // 'Instrument-Barometer'
  0x00, 0x00, 0x00, 0x00, 0x00, 0x00, 0x00, 0x00, 0x00, 0x00, 0x00, 0x00, 0x00, 0x00, 0x00, 0x00, 
  0x00, 0x00, 0x00, 0x03, 0xff, 0xf0, 0x00, 0x00, 0x00, 0x00, 0x00, 0x00, 0x00, 0x00, 0x00, 0x00, 
  0x00, 0x00, 0x00, 0x7f, 0xff, 0xff, 0x80, 0x00, 0x00, 0x00, 0x00, 0x00, 0x00, 0x00, 0x00, 0x00, 
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  0x00, 0x00, 0x00, 0x00, 0x00, 0x00, 0x00, 0x00, 0x00, 0x00, 0x00, 0x00, 0x00, 0x00, 0x00, 0x00, 
};

const unsigned char LightON [] PROGMEM = {
  // 'LightON'
  0x00, 0x00, 0x00, 0x00, 0x00, 0x00, 0x00, 0x00, 0x00, 0x00, 0x00, 0x00, 0x00, 0x00, 0x00, 0x00, 
  0x00, 0x00, 0x00, 0xfc, 0x00, 0x00, 0x00, 0x00, 0x00, 0x00, 0x00, 0x00, 0x00, 0x00, 0x00, 0x00, 
  0x00, 0x00, 0x1f, 0xff, 0xe0, 0x00, 0x00, 0x00, 0x00, 0x00, 0x00, 0x00, 0x00, 0x00, 0x00, 0x00, 
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  0x00, 0x00, 0x00, 0x00, 0x00, 0x00, 0x00, 0x00, 0x00, 0x00, 0x00, 0x00, 0x00, 0x00, 0x00, 0x00, 
};

const unsigned char Temperature [] PROGMEM = {
  // 'Temperature'
  0x00, 0x00, 0x00, 0x00, 0x00, 0x00, 0x00, 0x00, 0x00, 0x00, 0x00, 0x00, 0x00, 0x00, 0x00, 0x00, 
  0x00, 0x00, 0x3f, 0xe0, 0x00, 0x00, 0x00, 0x00, 0x00, 0x00, 0x00, 0x00, 0x00, 0x00, 0x00, 0x00, 
  0x00, 0x00, 0xff, 0xf8, 0x00, 0x00, 0x00, 0x00, 0x00, 0x00, 0x00, 0x00, 0x00, 0x00, 0x00, 0x00, 
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  0x00, 0x00, 0x00, 0x00, 0x00, 0x00, 0x00, 0x00, 0x00, 0x00, 0x00, 0x00, 0x00, 0x00, 0x00, 0x00, 
};

// End graphics

int fontSize = 1;
int LightSensorPin = A5;
float LightSensor = 0;
float temperature = 0;
float pressure = 0;
float humidity = 0;
float temperatureCalibration = 0.966;   // Temperature calibration correction value 0.915 drops by -1 oC
float pressureCalibration = 1.00701;    // Matched to office baro Pressure calibration correction value 1.00701
float humidityCalibration = 1.0;        // Humidity calibration correction value

long checkSum = 0;                      // zigbee checksum
byte BME280_TemperatureByteArray[4];    // holds the 4 byte IEEE754 convertion for zigbee frame
byte BME280_HumidityByteArray[4];
byte BME280_BaroByteArray[4];
byte LightLevelByteArray[4];
int  PowerUpMessagesCount = 0;           // Sends 30 messages every 10 seconds, then every 10 minutes
bool PostPowerUp = false;
byte TransmitStatus[] = {0x00,0x00,0x00,0x00,0x00,0x00,0x00,0x00,0x00,0x00,0x00};
byte success = false;                   // true = success
int  x = 0;                              // arrary index
int XbeeSkip = false;                  // if true then skip send to xbee
    

Adafruit_BME280 bme;                     // I2C
//Adafruit_BME280 bme(BME_CS);           // hardware SPI
//Adafruit_BME280 bme(BME_CS, BME_MOSI, BME_MISO,  BME_SCK);


void setup() {
 // Serial1.begin(9600);
  Serial.begin(9600);
  pinMode(BLUELED, OUTPUT);  
  pinMode(GREENLED, OUTPUT); 
  pinMode(REDLED, OUTPUT); 
  pinMode(LED_BUILTIN, OUTPUT);  

  if (!bme.begin()) {
    Serial.println("Could not find BME280 sensor!");
    while (1) {FlashErrorREDLED();}
  }
   LampTest();
   digitalWrite(LED_BUILTIN, LOW); 
  
  // by default, we'll generate the high voltage from the 3.3v line internally! (neat!)
  display.begin(SSD1306_SWITCHCAPVCC, 0x3C);  // initialize with the I2C addr 0x3D (for the 128x64)
  display.clearDisplay();
  display.display();
  display.setTextColor(WHITE,BLACK);
  display.setTextSize(2);
  display.setCursor(25,0);  //10,0
  display.print("GARAGE");
  display.setTextSize(1);
  display.setCursor(27,15);  
  display.print("ENV SENSORS");
  display.setCursor(19,23);  
  display.print("Richard Wilson");
  display.display();
  
  delay(5000);
}

void loop() {

   if(LightSensor < 50)
   {
        FlashBlueLED(10);
        delay(100);
        FlashBlueLED(10);
   }
   else
   {
        FlashBlueLED(100); 
        delay(100);  
        FlashBlueLED(100); 
   }
  
    ReadSensors(); // first read
    delay(700);
    DisplayLightData();
    delay(5000);
    DisplayHumData();
    delay(5000);
    DisplayBaroData();
    delay(5000);
    DisplayTempData();
    delay(5000);    // 5 mins

    LightSensor = GetLightReading(); // read the value from the light sensor and map to 0-100%:

    if(XbeeSkip == 10)  // send every 10 mins
    {
       if(LightSensor < 50)
       {
            FlashBlueLED(10);
            delay(100);
            FlashGreenLED(10);
            delay(100);
            FlashBlueLED(10);
       }
       else
       {
            FlashBlueLED(100); 
            delay(100);  
            FlashGreenLED(100); 
            delay(100); 
            FlashBlueLED(100);  
       }
       
      SendDataFrame();
      ProcessReply();
      XbeeSkip = 0; 
    } 
    
    XbeeSkip++;
    delay(60000);     // 5 mins  5=300000   60000 = 1 min
} 

void DisplayTempData()
{
   display.clearDisplay();
   display.setTextColor(WHITE,BLACK);  // White Text , Black background
   display.setTextSize(2);
   display.setCursor(33,0);  
   display.print("Temp" );
   display.setCursor(21,18);
   
   if(temperature < -100)
   {
    display.print("ERR");
   }
   else
   {
     display.print(temperature,2);
     display.setTextSize(1);
     display.setCursor(83,16);
     display.print("o"); 
     display.setTextSize(2);
     display.setCursor(89,17);
     display.print("C");   
   }
   display.display();  
}

void DisplayHumData()
{
   display.clearDisplay();
   display.setTextColor(WHITE,BLACK);  // White Text , Black background
   display.setTextSize(2);
   display.setCursor(15,0);  
   display.print("Humidity" );
   display.setCursor(43,18);
   
   if(humidity == 100)
   {
    display.print("ERR");
   }
   else
   {
     display.print(humidity,0);
     //display.print((char)248);
    display.print("%");  
   }
   display.display();  
}

void DisplayBaroData()
{
   display.clearDisplay();
   display.setTextColor(WHITE,BLACK);  // White Text , Black background
   display.setTextSize(2);
   display.setCursor(1,0);  
   display.print("BAROMETRIC" );
   display.setCursor(11,18);
   display.print(pressure,0);
   display.print(" hPa");  
   display.display();  
}

void DisplayLightData()
{
   display.clearDisplay();
   display.setTextColor(WHITE,BLACK);  // White Text , Black background
   display.setTextSize(2);
   display.setCursor(0,0);  
   display.print("Lights:" );

   if(GetLightReading() > 10)
   {
      display.print("ON");
   }
   else
   {
      display.print("OFF");
   }
   
   display.setCursor(5,20); 
   display.setTextSize(1); 
   display.print("SENSOR VALUE: " );
   display.print(analogRead(LightSensorPin));
   display.display();  
}

void SendDataFrame()
{
 // To calculate the check sum you add all bytes of the packet excluding the frame delimiter 7E and the length (the 2nd and 3rd bytes).
 // To calcualte length total byte count minus 3 ( first 3 bytes and checksum byte not included)
 // MAKE SURE THE Flow control is diabled on the XBEE !!
  long checkSum = 0x00;
  //unsigned long checkSum = 0x00;
   
  Serial.write((byte)0x7E);    //start byte
  Serial.write((byte)0x00);    // high part of lenght, alway zero
  Serial.write((byte)0x27);    // low part of lenght, number of bytes 0x27 = 39 dec
  Serial.write((byte)0x10); checkSum += 0x10;    // 0x10 send request
  Serial.write((byte)0x01); checkSum += 0x01;    // frame id set to zero for no reply, 01 for reply
  
  // ID of recipient, CO-ORDINATOR
  Serial.write((byte)0x00); //checkSum += 0x00;
  Serial.write((byte)0x13); checkSum += 0x13;
  Serial.write((byte)0xA2); checkSum += 0xA2;
  Serial.write((byte)0x00); checkSum += 0x00;
  Serial.write((byte)0x41); checkSum += 0x41;
  Serial.write((byte)0x63); checkSum += 0x63;
  Serial.write((byte)0x18); checkSum += 0x18;
  Serial.write((byte)0x45); checkSum += 0x45;

  // 16 bit of recipients or 0xFFFE if unkown
  Serial.write((byte)0xFF); checkSum += 0xFF;
  Serial.write((byte)0xFE); checkSum += 0xFE;
  Serial.write((byte)0x00); //checkSum += 0x00;
  Serial.write((byte)0x00); //checkSum += 0x00;

  // checkSum = 0x3C4;  //437;  // claculation of checksum from above bytes hex
   
  // Data frame 
  // ID
  Serial.write((byte)0x24); checkSum += 0x24; // $ 
  Serial.write((byte)0x30); checkSum += 0x30; // 0 
  Serial.write((byte)0x30); checkSum += 0x30; // 0
  Serial.write((byte)0x37); checkSum += 0x37; // 7
  Serial.write((byte)0x7C); checkSum += 0x7C; // |
  
  // BME280 Temperature  
   memcpy(BME280_TemperatureByteArray, &temperature,4);
   for(int i = 0; i < 4; i++)
   {
     Serial.write((byte)BME280_TemperatureByteArray[i]);
     checkSum += BME280_TemperatureByteArray[i];
   }
   Serial.write((byte)0x7C); checkSum += 0x7C; // |
  //---------------------------------------------------------------------------------------
  
  // BME 280 Humidity
   memcpy(BME280_HumidityByteArray, &humidity,4);
   for(int i = 0; i < 4; i++)
   {
     Serial.write((byte)BME280_HumidityByteArray[i]);
     checkSum += BME280_HumidityByteArray[i];
   }
    Serial.write((byte)0x7C); checkSum += 0x7C; // |
   //---------------------------------------------------------------------------------------

   // BME 280 Barometer
   memcpy(BME280_BaroByteArray, &pressure,4);
   for(int i = 0; i < 4; i++)
   {
     Serial.write((byte)BME280_BaroByteArray[i]);
     checkSum += BME280_BaroByteArray[i];
   }
     Serial.write((byte)0x7C); checkSum += 0x7C; // |
   //---------------------------------------------------------------------------------------

   // Light Level
   memcpy(LightLevelByteArray, &LightSensor,4);
   for(int i = 0; i < 4; i++)
   {
     Serial.write((byte)LightLevelByteArray[i]);
     checkSum += LightLevelByteArray[i];
   }
    Serial.write((byte)0x23); checkSum += 0x23; // #
   //---------------------------------------------------------------------------------------

    Serial.write((byte)0xFF - (checkSum & 0xFF));  // calc and send checksum
    checkSum = 0; // Reset checksum
   
  //  long sum = 0x17 + 0xFF + 0xFF + 0xFF + 0xFE + 0x02 +'D' + '1' + value;
  //  Serial111.write(0xFF - (sum & 0xFF), BYTE);  calc checksum
}  

void ReadSensors()
{
    temperature = bme.readTemperature();
    temperature = (temperature * temperatureCalibration);
//    Serial.print("Temperature = ");
//    Serial.print(temperature);
//    Serial.println(" *C");

    pressure = bme.readPressure() / 100.0F;
    pressure = (pressure * pressureCalibration);
//    Serial.print("Pressure = ");
//    Serial.print(pressure);
//    Serial.println(" hPa");

    humidity = bme.readHumidity();
    humidity = (humidity * humidityCalibration); 
//    Serial.print("Humidity = ");
//    Serial.print(humidity);
//    Serial.println(" %");
//    Serial.print("Light % = ");
//    Serial.println(LightSensor);
//    Serial.println("");
}

int GetLightReading()
{
   LightSensor = analogRead(LightSensorPin);
    
    if(LightSensor < 551)
       LightSensor = 551;
    else if (LightSensor > 750)
       LightSensor = 750;
    
    return map(LightSensor, 551, 750, 0, 100);
}

void LampTest()
{
  for(int l = 0; l < 10; l++)
  {
     digitalWrite(REDLED,HIGH);
     digitalWrite(BLUELED,HIGH);
     digitalWrite(GREENLED,HIGH);
     delay(500);
     digitalWrite(REDLED,LOW);
     digitalWrite(BLUELED,LOW);
     digitalWrite(GREENLED,LOW);
     delay(500);
   }
}

void FlashFlashREDLED()
{
   for(int q = 0; q < 81;q++)
   {
      digitalWrite(REDLED,HIGH);
      delay(50);
      digitalWrite(REDLED,LOW);
      delay(50);
   }
      digitalWrite(REDLED,LOW);
}

void ProcessReply()
{
    //byte TransmitStatus[] = {0x00,0x00,0x00,0x00,0x00,0x00,0x00,0x00,0x00,0x00,0x00};
    //byte success = false;  // true = success
    //int x = 0; // arrary index
    delay(1000);
    while(Serial.available() > 0)
    {
        TransmitStatus[x] = Serial.read();  // x 0-10 (11 bytes)
        //Serial1.write((byte)TransmitStatus[x]);
        x++;
    }
        x = 0;                                // reset index

    if(TransmitStatus[0] == 0x7E)            // check for frame start
    {
        if(TransmitStatus[3] == 0x8B)        // Frame type 8B = reply
        {
            if(TransmitStatus[8] == 0x00)    // 0x00 is Success
            {
                delay(500);
                success = 0x00;  // Success
                
                if(LightSensor < 50)
                {
                  FlashBlueLED(10);
                  delay(100);
                  FlashGreenLED(10);
                  delay(100);
                }
                else
                {
                  FlashBlueLED(100);
                  delay(100);
                  FlashGreenLED(100);
                  delay(100);
                }
            }
            else
            {
                success = 0xFF;  // failure
            }
        }
        else
        {
            success = 0xFF;      // failure
        }
      
    if(success != 0x00)
    {
        FlashFlashREDLED();       // red led
    }
  }
    
    for(int z = 0; z < 10; z++)
    {
      TransmitStatus[z] = 0x00;  // clean out the xbee reply frame buffer
    }   
}

void FlashGreenLED( int Brightness)
{
  for(int f = 0; f<200; f++)
  {
    digitalWrite(GREENLED,HIGH);  // if you want use the analogpins as digital than A0-> 14 ,A1->15,..etc
    delayMicroseconds(Brightness);
    digitalWrite(GREENLED,LOW);
    delayMicroseconds(900);
  }
}

void FlashRedLED( int Brightness)
{
  for(int f = 0; f<200; f++)
  {
    digitalWrite(REDLED,HIGH);  // if you want use the analogpins as digital than A0-> 14 ,A1->15,..etc
    delayMicroseconds(Brightness);
    digitalWrite(REDLED,LOW);
    delayMicroseconds(900);
  }
}

void FlashBlueLED(int Brightness)
{
  for(int f = 0; f<200; f++)
  {
    digitalWrite(BLUELED,HIGH);  // if you want use the analogpins as digital than A0-> 14 ,A1->15,..etc
    delayMicroseconds(Brightness);
    digitalWrite(BLUELED,LOW);
    delayMicroseconds(900);
  }
}

void FlashErrorREDLED()
{
  for (int w = 0; w < 20; w++)
  {
    for(int q = 0; q < 3;q++)
     {
        digitalWrite(REDLED,HIGH);
        delay(50);
        digitalWrite(REDLED,LOW);
        delay(50);
     }
        digitalWrite(REDLED,LOW);
        delay(900); 
  }    
}



